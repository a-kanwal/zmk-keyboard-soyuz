## boards/shields/numby/Kconfig.defconfig
```kconfig
# Copyright (c) 2020 The ZMK Contributors
# SPDX-License-Identifier: MIT

if SHIELD_NUMBY

config ZMK_KEYBOARD_NAME
	default "nUMBY"

endif
```

## boards/shields/numby/Kconfig.shield
```kconfig
# Copyright (c) 2020 The ZMK Contributors
# SPDX-License-Identifier: MIT

config SHIELD_NUMBY
	def_bool $(shields_list_contains,numby)
```

## boards/shields/soyuz/Kconfig.defconfig
```kconfig
if SHIELD_SOYUZ
config ZMK_KEYBOARD_NAME
    # ≤15 chars for USB/BLE name
    default "Soyuz"
endif
```

## boards/shields/soyuz_bak/Kconfig.shield
```kconfig
# No whitespace in the name!
config SHIELD_SOYUZ
    def_bool $(shields_list_contains,soyuz)
```
